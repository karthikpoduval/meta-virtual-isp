## conf/layer.conf
```bitbake
# We have a conf and classes directory, add to BBPATH
BBPATH .= ":${LAYERDIR}"

# We have recipes-* directories, add to BBFILES
BBFILES += "${LAYERDIR}/recipes-*/*/*.bb \
            ${LAYERDIR}/recipes-*/*/*.bbappend"

BBFILE_COLLECTIONS += "meta-virtual-isp"
BBFILE_PATTERN_meta-virtual-isp = "^${LAYERDIR}/"
BBFILE_PRIORITY_meta-virtual-isp = "6"

LAYERDEPENDS_meta-virtual-isp = "core"
LAYERSERIES_COMPAT_meta-virtual-isp = "nanbield"
```
